## ble_ota/Kconfig
```kconfig
menu "OTA Manager"
    choice OTA_TYPE
        prompt "Type of OTA"
        default OTA_WITHOUT_SECURITY

        config OTA_WITHOUT_SECURITY
            bool "Enable OTA without security"
            help
                This transfers file without any security using OTA

        config PRE_ENC_OTA
            bool
            prompt "Enable pre encrypted OTA"
            depends on BT_NIMBLE_ENABLED
            help
                Used to enable transferring pre encrypted file via OTA
    endchoice

    config BLE_OTA_EXTERNAL_HOST
        bool "Use an application-owned NimBLE host"
        depends on BT_NIMBLE_ENABLED
        default n
        help
            The component no longer initializes NimBLE, sets the device name, advertises or
            handles GAP events. The application registers the OTA service from
            esp_ble_ota_gatt_svcs() before the GATT server starts (or with
            esp_ble_ota_gatt_register() under CONFIG_BT_NIMBLE_DYNAMIC_SERVICE) and forwards
            connect, disconnect and subscribe events through esp_ble_ota_on_connect(),
            esp_ble_ota_on_disconnect() and esp_ble_ota_on_subscribe().
endmenu
```
